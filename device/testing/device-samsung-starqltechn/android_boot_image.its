## device/testing/device-samsung-starqltechn/android_boot_image.its
```
/dts-v1/;

/ {
        description = "Samsung S9 SM-G9600 starqltechn Android FIT Image";
        #address-cells = <1>;

        images {
                prebootscript {
                        description = "pre Boot script";
                        data = /incbin/("bootscript_android.sh");
                        type = "script";
                        compression = "none";
                        load = <0x90000000>;
                        entry = <0x90000000>;
                        hash {
                                algo = "sha1";
                        };
                };
                bootscript {
                        description = "Boot script";
                        data = /incbin/("bootscript_android.sh");
                        type = "script";
                        compression = "none";
                        load = <0x90000000>;
                        entry = <0x90000000>;
                        hash {
                                algo = "sha1";
                        };
                };
                kernel {
                        description = "Kernel";
                        data = /incbin/("/boot/android/android.img-kernel");
                        type = "kernel";
                        arch = "arm64";
                        os = "linux";
                        compression = "gzip";
                        load = <0x80200000>;
                        entry = <0x80200000>;
                        hash {
                                algo = "sha1";
                        };
                };
                initrd {
                        description = "Initrd";
                        compression = "none";
                        data = /incbin/("/boot/android/android.img-ramdisk");
                        type = "ramdisk";
                        arch = "arm64";
                        load = <0x84000000>;
                        os = "linux";
                        hash {
                                algo = "sha1";
                        };
                };
        };

        configurations {
                default = "standard";
                standard {
                        description = "Standard Boot";
                        kernel = "kernel";
                        ramdisk = "initrd";
                        hash {
                                algo = "sha1";
                        };
                };
        };
};
```

## device/testing/device-samsung-starqltechn/find_image_and_boot.its
```
/dts-v1/;

/ {
        description = "Samsung S9 SM-G9600 starqltechn boot script";
        #address-cells = <1>;

        images {
                bootscript {
                        description = "Boot script";
                        data = /incbin/("find_image_and_boot.sh");
                        type = "script";
                        compression = "none";
                        load = <0x90000000>;
                        entry = <0x90000000>;
                        hash {
                                algo = "sha1";
                        };
                };

                 prebootscript {
                         description = "pre boot script";
                         data = /incbin/("find_image_and_boot.sh");
                         type = "script";
                         compression = "none";
                         load = <0x90000000>;
                         entry = <0x90000000>;
                         hash {
                                 algo = "sha1";
                         };
                 };
        };
};
```
